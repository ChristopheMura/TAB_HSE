## sdkconfig.defaults
```kconfig
# Console et révision de puce (Tab5 = P4 v1.x)
CONFIG_ESP_CONSOLE_USB_SERIAL_JTAG=y
CONFIG_ESP32P4_SELECTS_REV_LESS_V3=y

# Flash et partitions
CONFIG_ESPTOOLPY_FLASHSIZE_16MB=y
CONFIG_PARTITION_TABLE_SINGLE_APP_LARGE=y

CONFIG_CODEC_I2C_BACKWARD_COMPATIBLE=n

# SPIRAM for ESP32-P4
CONFIG_SPIRAM=y
CONFIG_SPIRAM_SPEED_200M=y
CONFIG_IDF_EXPERIMENTAL_FEATURES=y

# Camera config
CONFIG_FREERTOS_HZ=1000
CONFIG_ESP_VIDEO_ENABLE_ISP_PIPELINE_CONTROLLER=y
CONFIG_CAMERA_SC202CS=y
CONFIG_CAM_CTRL_SPI_ENABLE=n

## LVGL9 ##
CONFIG_LV_CONF_SKIP=y
CONFIG_LV_BUILD_EXAMPLES=n

# CLIB default
CONFIG_LV_USE_CLIB_MALLOC=y
CONFIG_LV_USE_CLIB_SPRINTF=y
CONFIG_LV_USE_CLIB_STRING=y

# Performance monitor
CONFIG_LV_USE_OBSERVER=y
CONFIG_LV_USE_SYSMON=y
CONFIG_LV_USE_PERF_MONITOR=y
```
